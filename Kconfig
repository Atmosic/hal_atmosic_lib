## Kconfig
```kconfig
# Copyright (c) 2023-2024 Atmosic
#
# SPDX-License-Identifier: Apache-2.0

config ZSG_TOOL_PATH
	string "ZSG tool path"
	default "${ZEPHYR_BASE}/../modules/hal/atmosic_lib/tools/zsg"
```
